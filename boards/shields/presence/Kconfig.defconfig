## boards/shields/presence/Kconfig.defconfig
```kconfig
# Copyright (c) 2022 The ZMK Contributors
# SPDX-License-Identifier: MIT

if SHIELD_PRESENCE

config ZMK_KEYBOARD_NAME
    default "presence"

endif # SHIELD_PRESENCE
```

## boards/shields/presence/Kconfig.shield
```kconfig
# Copyright (c) 2022 The ZMK Contributors
# SPDX-License-Identifier: MIT

config SHIELD_PRESENCE
    def_bool $(shields_list_contains,presence)
```
